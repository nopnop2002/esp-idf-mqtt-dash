## gpio-control/main/Kconfig.projbuild
```kconfig
menu "Application Configuration"

	menu "WiFi Setting"

		config ESP_WIFI_SSID
			string "WiFi SSID"
			default "myssid"
			help
				SSID (network name) to connect to.

		config ESP_WIFI_PASSWORD
			string "WiFi Password"
			default "mypassword"
			help
				WiFi password (WPA or WPA2) to use.

		config ESP_MAXIMUM_RETRY
			int "Maximum retry"
			default 5
			help
				Set the Maximum retry to avoid station reconnecting to the AP unlimited when the AP is really inexistent.

	endmenu

	menu "MQTT Server Setting"

		config MQTT_BROKER
			string "MQTT Broker"
			default "broker.emqx.io"
			help
				Host name or IP address of the broker to connect to.

		config MQTT_SUB_TOPIC
			string "Subscribe Topic"
			default "/esp32/gpio/#"
			help
				Topic of subscribe

		config BROKER_AUTHENTICATION
			bool "Server requests for password when connecting"
			default false
			help
				Server requests for password when connecting.

		config AUTHENTICATION_USERNAME
			depends on BROKER_AUTHENTICATION
			string "Username used for connecting to the broker"
			default "user"
			help
				Username used for connecting to the broker.

		config AUTHENTICATION_PASSWORD
			depends on BROKER_AUTHENTICATION
			string "Password used for connecting to the broker"
			default "password"
			help
				Username used for connecting to the broker.

	endmenu

endmenu
```

## ir-control/main/Kconfig.projbuild
```kconfig
menu "Application Configuration"

	config GPIO_RANGE_MAX
		int
		default 33 if IDF_TARGET_ESP32
		default 46 if IDF_TARGET_ESP32S2
		default 19 if IDF_TARGET_ESP32C3
		default 48 if IDF_TARGET_ESP32S3

	menu "WiFi Setting"

		config ESP_WIFI_SSID
			string "WiFi SSID"
			default "myssid"
			help
				SSID (network name) to connect to.

		config ESP_WIFI_PASSWORD
			string "WiFi Password"
			default "mypassword"
			help
				WiFi password (WPA or WPA2) to use.

		config ESP_MAXIMUM_RETRY
			int "Maximum retry"
			default 5
			help
				Set the Maximum retry to avoid station reconnecting to the AP unlimited when the AP is really inexistent.

	endmenu

	menu "MQTT Server Setting"

		config MQTT_BROKER
			string "MQTT Broker"
			default "broker.emqx.io"
			help
				Host name or IP address of the broker to connect to.

		config MQTT_SUB_TOPIC
			string "Subscribe Topic"
			default "/esp32/remote/#"
			help
				Topic of subscribe

		config BROKER_AUTHENTICATION
			bool "Server requests for password when connecting"
			default false
			help
				Server requests for password when connecting.

		config AUTHENTICATION_USERNAME
			depends on BROKER_AUTHENTICATION
			string "Username used for connecting to the broker"
			default "user"
			help
				Username used for connecting to the broker.

		config AUTHENTICATION_PASSWORD
			depends on BROKER_AUTHENTICATION
			string "Password used for connecting to the broker"
			default "password"
			help
				Username used for connecting to the broker.


	endmenu

	menu "IR Transmitter Setting"

		config RMT_TX_GPIO_NUM
			int "IR Transmitter GPIO"
			range 0 GPIO_RANGE_MAX
			default 12
			help
				IR Transmitter GPIO.
	endmenu

endmenu
```
